## boards/shields/endeffector/Kconfig.shield
```kconfig
config SHIELD_ENDEFFECTOR_LEFT
    def_bool $(shields_list_contains,endeffector_left)
  
config SHIELD_ENDEFFECTOR_RIGHT
    def_bool $(shields_list_contains,endeffector_right)
  
config SHIELD_ENDEFFECTOR_DONGLE
    def_bool $(shields_list_contains,endeffector_dongle)
```
